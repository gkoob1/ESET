; THIS CODE IS FOR THE PIC 18F4550 MICROCONTROLLERS
; NAME:	koob_graham
; DATE: 2009-09-23  

#include	p18f4550.inc	;pre-defined PIC specific definitions
;**************************************************************************
;	START OF CODE SECTION
;**************************************************************************
COUNTER	EQU	20H			; VARIABLE LOCATION
A		EQU 00H			; Access Bank

	ORG	00h				; RESET VECTOR OR POWER ON
; Configuration Bytes are set up here for automatic load to Micro
; All definitions are in the P18F4550.INC file (Commented area at the end, Pg.18)
; CONFIG1L	300000 = 21H
	CONFIG	USBDIV = 2			; USB LCK source comes form the 96MHz PLL divided by 2
	CONFIG	CPUDIV = OSC1_PLL2	; OSC1/OSC2 SOURCE/1 96MHz PLL SOURCE/2
	CONFIG	PLLDIV = 2			; DIVIDE BY 2 - 8MHz OSCILLATOR I/P
; CONFIG1H	300001 = 0CH
	CONFIG	IESO = OFF			; Oscillator switch over mode DISABLED	
	CONFIG	FCMEN = OFF			; FAIL SAFE MONITOR DISABLED 
	CONFIG	FOSC = HS			; HIGH SPEED OSCILLATOR, PLL DISABLED
; CONFIG2L	300002 = 26H
	CONFIG	PWRT = ON			; POWER UP DIMER ENABLED
	CONFIG	BOR = ON			; BROWN OUT RESET ENABLED IN HARDWARE ONLY
	CONFIG	BORV = 0			; BROWN OUT RESET AT 4.6V 
	CONFIG	VREGEN = ON			; USB VOLTAGE REGULATOR ENABLED
; CONFIG2H	300003 = 1EH
	CONFIG	WDT = OFF			; WATCH DOG TIMER OFF (POST SCALER NOT SET)
; CONFIG3L	300004 = ??H		; No information for this register
; CONFIG3H	300005 = 85H		; Reset enabled, low power OSC1, PORT B DIGITAL not A2D
	CONFIG	MCLRE = ON			; MASTER CLEAR PIN IS ENABLED (RESET) 
	CONFIG	LPT1OSC = ON		; TIMER 1 OSCILLATOR CONFIGURED FOR HIGHER POWER OPERATION
	CONFIG	PBADEN = OFF		; PORTB PINS ARE CONFIGURED FOR DIGITAL ON RESET
; CONFIG4L	300006 = 80H		; STACK UNDER FLOW RESET OFF, LVP OFF, PROG PORT OFF, NO EXTRA INST, RB6-7 IO
	CONFIG	STVREN = OFF		; STACK UNDERFLOW WILL NOT CAUSE A RESET
	CONFIG	LVP = OFF			; LOW VOLTAGE IN CCT PROGRAMMING DISABLED
	CONFIG	ICPRT = OFF			; DEDICATED IN CCT PROGRAMMING PORT DISABLED (RB6 & RB7)
	CONFIG	XINST = OFF			; NO EXTRA INSTRUCTIONS 
	CONFIG	DEBUG = OFF			; BACK GROUND DEBUGGING DISABLED (RB6 & RB7 NORMAL MODE)
; CONFIG4H	300007 = ??H		; No information for this register
; CONFIG5L	300008 = 0FH		; All code protection OFF
; CONFIG5H	300009 = C0H		; All code protection OFF
; CONFIG6L	30000A = OFH		; All not WRITE PROTECTED
; CONFIG6H	30000B = E0H		; All not WRITE PROTECTED
; CONFIG7L	30000C = 0FH		; All not READ PROTECTED
; CONFIG7H	30000D = 40H		; Not READ PROTECTED


PORT_INIT:
	MOVLW	1EH			; VREF- = GND, VREF+ = AN3
	MOVWF	ADCON1,A	; AN0 = ANALOG

	MOVLW	06H			; RA<5:4> = SW3, SW2, 
	MOVWF	PORTA,A		; RA<3:0> = VREF (U2), Chip Select (U4),
						; O/P External Connector (J1), Wiper I/P from DIG Pot (U5) [ANALOG]

	MOVLW	39H			; 
	MOVWF	TRISA,A		; Configure PORTA

	MOVLW	08H			; RB<7:4> = KeyBoard 
	MOVWF	PORTB,A		; RB<3:2> = DIG POT (U5) & Chip Select, RTC
						; RB<1:0> = I2C

	MOVLW	0F7H		;
	MOVWF	TRISB,A		; Configure PORTB

	MOVLW	7AH			; RC<7:4> = Serial I/P, Serial O/P, USB [NOT USED]
	MOVWF	PORTC,A		; RC<3:0> = N/A, I/P External Connector (J1), YEL_LED (D3) [ON], RED_LED (D2) [ON]

	MOVLW	80H			;
	MOVWF	TRISC,A		; Configure PORTC

	MOVLW	0FFH		; RD<7:4> = LCD
	MOVWF	PORTD,A		; RD<3:0> = KeyPad

	MOVLW	00H			;
	MOVWF	TRISD,A		; Configure PORTD

	MOVLW	00H			; RE<7:4> = N/A
	MOVWF	PORTE,A		; RE<3:0> = LCD Data/Command, LCD Read/Write, LCD Chip Select [Active HIGH]

	MOVLW	00H			;
	MOVWF	TRISE,A		; Configure PORTE

	MOVLW	07H			; COMPARATOR OFF
	MOVWF	CMCON,A		; CONFIGURE COMPARATOR 

MAIN_LOOP:
	BSF		PORTC,RC1,A	; TURN ON YEL_LED
	BSF		PORTC,RC0,A	; TURN ON RED_LED
	BCF		PORTC,RC1,A	; TURN OFF YEL_LED
	BCF		PORTC,RC0,A	; TURN OFF RED_LED
	GOTO	MAIN_LOOP

;**************************************************************************
; Include *.asm files here
	END
