; THIS CODE IS FOR THE PIC 18F4550 MICROCONTROLLER. It will configure 
; the bits.
; NAME:	koob_graham
; DATE: 2009-09-23  
;**************************************************************************
;	START OF CODE SECTION
;**************************************************************************
; Configuration Bytes are set up here for automatic load to Micro
; All definitions are in the P18F4550.INC file (Commented area at the end, Pg.18)
; CONFIG1L	300000 = 21H
	CONFIG	USBDIV = 2			; USB LCK source comes form the 96MHz PLL divided by 2
	CONFIG	CPUDIV = OSC1_PLL2	; OSC1/OSC2 SOURCE/1 96MHz PLL SOURCE/2
	CONFIG	PLLDIV = 2			; DIVIDE BY 2 - 8MHz OSCILLATOR I/P
; CONFIG1H	300001 = 0CH
	CONFIG	IESO = OFF			; Oscillator switch over mode DISABLED	
	CONFIG	FCMEN = OFF			; FAIL SAFE MONITOR DISABLED 
	CONFIG	FOSC = HS			; HIGH SPEED OSCILLATOR, PLL DISABLED
; CONFIG2L	300002 = 26H
	CONFIG	PWRT = ON			; POWER UP DIMER ENABLED
	CONFIG	BOR = ON			; BROWN OUT RESET ENABLED IN HARDWARE ONLY
	CONFIG	BORV = 0			; BROWN OUT RESET AT 4.6V 
	CONFIG	VREGEN = ON			; USB VOLTAGE REGULATOR ENABLED
; CONFIG2H	300003 = 1EH
	CONFIG	WDT = OFF			; WATCH DOG TIMER OFF (POST SCALER NOT SET)
; CONFIG3L	300004 = ??H		; No information for this register
; CONFIG3H	300005 = 85H		; Reset enabled, low power OSC1, PORT B DIGITAL not A2D
	CONFIG	MCLRE = ON			; MASTER CLEAR PIN IS ENABLED (RESET) 
	CONFIG	LPT1OSC = ON		; TIMER 1 OSCILLATOR CONFIGURED FOR HIGHER POWER OPERATION
	CONFIG	PBADEN = OFF		; PORTB PINS ARE CONFIGURED FOR DIGITAL ON RESET
; CONFIG4L	300006 = 80H		; STACK UNDER FLOW RESET OFF, LVP OFF, PROG PORT OFF, NO EXTRA INST, RB6-7 IO
	CONFIG	STVREN = OFF		; STACK UNDERFLOW WILL NOT CAUSE A RESET
	CONFIG	LVP = OFF			; LOW VOLTAGE IN CCT PROGRAMMING DISABLED
	CONFIG	ICPRT = OFF			; DEDICATED IN CCT PROGRAMMING PORT DISABLED (RB6 & RB7)
	CONFIG	XINST = OFF			; NO EXTRA INSTRUCTIONS 
	CONFIG	DEBUG = OFF			; BACK GROUND DEBUGGING DISABLED (RB6 & RB7 NORMAL MODE)
; CONFIG4H	300007 = ??H		; No information for this register
; CONFIG5L	300008 = 0FH		; All code protection OFF
; CONFIG5H	300009 = C0H		; All code protection OFF
; CONFIG6L	30000A = OFH		; All not WRITE PROTECTED
; CONFIG6H	30000B = E0H		; All not WRITE PROTECTED
; CONFIG7L	30000C = 0FH		; All not READ PROTECTED
; CONFIG7H	30000D = 40H		; Not READ PROTECTED
